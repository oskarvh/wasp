## boards/wasp/wasp_node/Kconfig.defconfig
```kconfig
# wasp node board configuration
#
# Copyright (c) 2026 Oskar von Heideken
# SPDX-License-Identifier: Apache-2.0

if BOARD_WASP_NODE

configdefault NET_L2_ETHERNET
	default y

endif # BOARD_WASP_NODE
```

## boards/wasp/wasp_node/Kconfig.wasp_node
```kconfig
# Copyright (c) 2026 Oskar von Heideken
# SPDX-License-Identifier: Apache-2.0

config BOARD_WASP_NODE
	select SOC_STM32H723XX
```

## boards/wasp/wasp_node/board.yml
```yaml
board:
  name: wasp_node
  full_name: wasp node board (rev V1)
  vendor: wasp
  socs:
    - name: stm32h723xx
```

## dts/bindings/ethernet/wasp,ksz8794.yaml
```yaml
# Copyright (c) 2026 Oskar von Heideken
# SPDX-License-Identifier: Apache-2.0

description: |
  Microchip KSZ8794CNX 3-port 10/100 managed Ethernet switch, reached over
  its SPI client interface (SPI mode 0, max 25 MHz).

  This is not a Zephyr Ethernet switch driver — the switch fabric forwards
  without any host involvement. The node exists so the application can fix
  up the handful of registers whose reset-strap defaults are wrong for the
  board, above all the port 4 interface mode: the strap pins read RGMII and
  the board is wired RMII.

compatible: "wasp,ksz8794"

include: spi-device.yaml

properties:
  reset-gpios:
    type: phandle-array
    description: |
      RST# (active low).

      Optional, and normally left undriven: boards that hold RST# with an
      RC need no help, and on a board whose HSE is fed from the switch's
      REFCLKO, asserting this while the MCU runs on HSE stops the MCU's own
      clock. See CONFIG_WASP_KSZ8794_HW_RESET.
```

## dts/bindings/mtd/wasp,vti7064-psram.yaml
```yaml
# Copyright (c) 2026 Oskar von Heideken
# SPDX-License-Identifier: Apache-2.0

description: |
  Vilsion VTI7064 64 Mbit quad SPI/QPI PSRAM on an STM32 OCTOSPI, mapped
  into the address space for both read and write.

  Zephyr's st,stm32-ospi-psram driver cannot drive this part: it is an
  octal (8-line) HyperRAM/Xccela driver for AP Memory APS256XX-class
  devices, with 8-line instruction, address and data phases and
  MEMTYPE_APMEMORY. This is a 4-line SOIC-8 part with the APS6404L-style
  command set, so it gets its own driver.

compatible: "wasp,vti7064-psram"

include: [base.yaml]

properties:
  reg:
    required: true

  size:
    type: int
    required: true
    description: Density in bits.

  max-frequency:
    type: int
    required: true
    description: |
      Maximum OCTOSPI clock in Hz. The driver picks the fastest integer
      prescaler of the OSPI kernel clock that does not exceed this, and
      logs what it achieved.

  wasp,tcem-ns:
    type: int
    required: true
    description: |
      tCEM: the longest the device tolerates chip select held low, in ns.
      Exceeding it blocks the internal refresh and the array loses data
      with nothing reported, so the driver converts this into OCTOSPI's
      DCR4 refresh counter against the clock it actually achieved rather
      than trusting a hand-computed cycle count.

  st,csbound:
    type: int
    default: 10
    description: |
      Release chip select on a 2^n byte boundary. Defaults to the 1 Kbyte
      page size, which keeps a memory-mapped burst from straddling two
      pages.
```
